## windowProject/window_project_v6/main/Kconfig.projbuild
```kconfig
menu "Example Configuration"

    config EXAMPLE_BOARD_BUTTON_GPIO
        int "Boot Button GPIO"
        default 9 if IDF_TARGET_ESP32C3 || IDF_TARGET_ESP32C6
        default 0
        help
            GPIO number on which the "Boot" button is connected. This is generally used
            by the application for custom operations like toggling states, resetting to defaults, etc.

    config EXAMPLE_OUTPUT_GPIO
        int "Output GPIO"
        default 19
        help
            This is an output GPIO that will be connected to a relay or other driver circuit in most cases.
            If the power changes, this GPIO output level will also change.


    config GPIO_INPUT_0
        int "GPIO input pin 0"
        default 23
        help
            GPIO pin number to be used as GPIO_INPUT_IO_0. Pulled up, interrupt from rising edge and falling edge


endmenu
```
